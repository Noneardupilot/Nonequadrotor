/******************************************************************************************************************
**头文件说明 ： ms5611驱动配置
**时      间 ： 2018-4-30
**作      者 ： 历小伟
**联系 方式  ： 15982962929
**备      注 ： 采用spi驱动ms611
******************************************************************************************************************/


/*=============================================================================================================
                                         头文件START
==============================================================================================================*/

#include "dev_ms5611.h"
#include "copter.h"



DEV_MS5611::CalReg   calReg;
static unsigned int    _msl_pressure = 101325;	/* in Pa */
/*=============================================================================================================
                                         头文件START
==============================================================================================================*/
/*====================================================================================================*/
/*====================================================================================================*
**函数原型 : void MS5611_Reset(void)
**功    能 : MS5611复位
**输    入 : None
**输    出 : None
**备    注 : 
**====================================================================================================*/
/*====================================================================================================*/
void DEV_MS5611::IIC_MS5611_Reset(void)
{
    IIC2.IIC_Write_1Byte(MS5611_ADDR, MS5611_CMD_RESET, 1);
	  System_set.delay_ms(2800);
}


/*====================================================================================================*/
/*====================================================================================================*
**函数原型 : u8 MS5611_Read_Prom(void)
**功    能 : MS5611读取内部ROM
**输    入 : None
**输    出 : None
**备    注 : 
**====================================================================================================*/
/*====================================================================================================*/
u8 DEV_MS5611::IIC_MS5611_Read_Prom(void)
{
	uint8_t rxbuf[2] = { 0, 0 };
	u8 check = 0;
	u8 i;

	for (i = 0; i < MS5611_PROM_NB; i++)
	{
		check += IIC2.IIC_Read_nByte(MS5611_ADDR, MS5611_CMD_PROM_RD + i * 2, 2, rxbuf); // send PROM READ command
		ms5611_prom[i] = rxbuf[0] << 8 | rxbuf[1];
	}

	if(check==MS5611_PROM_NB)
		return 1;
	else
		return 0;
}

/*====================================================================================================*/
/*====================================================================================================*
**函数原型 : void MS5611_Read_Adc_Temperature(void)
**功    能 : 读取MS5611的24位温度ADC
**输    入 : None
**输    出 : None
**备    注 : 
**====================================================================================================*/
/*====================================================================================================*/
void DEV_MS5611::IIC_MS5611_Read_Adc_Temperature(void)
{
	IIC2.IIC_Read_nByte( MS5611_ADDR, MS5611_CMD_ADC_READ, 3, temp_rxbuf ); // read ADC
}


/*====================================================================================================*/
/*====================================================================================================*
**函数原型 : void MS5611_Read_Adc_Pressure(void)
**功    能 : MS5611的压力值读取
**输    入 : None
**输    出 : None
**备    注 : 
**====================================================================================================*/
/*====================================================================================================*/
void DEV_MS5611::IIC_MS5611_Read_Adc_Pressure(void)
{
	IIC2.IIC_Read_nByte(MS5611_ADDR, MS5611_CMD_ADC_READ, 3, press_rxbuf); // read ADC
}


/*====================================================================================================*/
/*====================================================================================================*
**函数原型 : void MS5611_Start_Temperature(void)
**功    能 : 开始转换
**输    入 : None
**输    出 : None
**备    注 : 
**====================================================================================================*/
/*====================================================================================================*/

void DEV_MS5611::IIC_MS5611_Start_Temperature(void)
{
//	IIC2.IIC_Write_1Byte(MS5611_ADDR, MS5611_CMD_ADC_CONV + MS5611_CMD_ADC_D2 + MS5611_OSR, 1); // D2 (temperature) conversion start!
}

/*====================================================================================================*/
/*====================================================================================================*
**函数原型 : void MS5611_Start_Press(void)
**功    能 : 压力开始转换
**输    入 : None
**输    出 : None
**备    注 : 
**====================================================================================================*/
/*====================================================================================================*/
void DEV_MS5611::IIC_MS5611_Start_Press(void)
{
//  IIC2.IIC_Write_1Byte(MS5611_ADDR, MS5611_CMD_ADC_CONV + MS5611_CMD_ADC_D1 + MS5611_OSR, 1); // D1 (pressure) conversion start!
}

/*====================================================================================================*/
/*====================================================================================================*
**函数原型 : void MS5611_Init(void)
**功    能 : 压力开始转换
**输    入 : None
**输    出 : None
**备    注 : 
**====================================================================================================*/
/*====================================================================================================*/
u8 ms5611_ok; //传感器是否是好的
void DEV_MS5611::IIC_MS5611_Init(void)
{
	
	System_set.delay_ms(10);
	//传感器复位
	IIC_MS5611_Reset();
	System_set.delay_ms(3);
	ms5611_ok = !( IIC_MS5611_Read_Prom() );
	//开始读取温度
	IIC_MS5611_Start_Temperature();
}

/*====================================================================================================*/
/*====================================================================================================*
**函数原型 : int MS5611_Update(void)
**功    能 : 更新
**输    入 : None
**输    出 : None
**备    注 : 
**====================================================================================================*/
/*====================================================================================================*/
int DEV_MS5611::IIC_MS5611_Update(void)
{
	static int state = 0;
	
//	I2C_FastMode = 0;
	
	if (state) 
	{
			IIC_MS5611_Read_Adc_Pressure();
			IIC_MS5611_Start_Temperature();
			IIC_MS5611_BaroAltCalculate();
			state = 0;
	} 
	else 
	{
			IIC_MS5611_Read_Adc_Temperature();
			IIC_MS5611_Start_Press();
			state = 1;
	}
	return (state);
}


/*====================================================================================================*/
/*====================================================================================================*
**函数原型 : void MS5611_BaroAltCalculate(void)
**功    能 : 计算
**输    入 : None
**输    出 : None
**备    注 : 
**====================================================================================================*/
/*====================================================================================================*/
float temperature_5611;
int32_t ms5611_pressure;
void DEV_MS5611::IIC_MS5611_BaroAltCalculate(void)
{
	static u8 baro_start;
	
  int32_t temperature, off2 = 0, sens2 = 0, delt;
  int32_t pressure;
	float alt_3;
	
	int32_t dT;
	int64_t off;
	int64_t sens;
	
		static vs32 sum_tmp_5611 = 0;
		static u8 sum_cnt = BARO_CAL_CNT + 10;
	
		ms5611_ut = (temp_rxbuf[0] << 16) | (temp_rxbuf[1] << 8) | temp_rxbuf[2];
		ms5611_up = (press_rxbuf[0] << 16) | (press_rxbuf[1] << 8) | press_rxbuf[2];
		
    dT = ms5611_ut - ((uint32_t)ms5611_prom[5] << 8);
    off = ((uint32_t)ms5611_prom[2] << 16) + (((int64_t)dT * ms5611_prom[4]) >> 7);
    sens = ((uint32_t)ms5611_prom[1] << 15) + (((int64_t)dT * ms5611_prom[3]) >> 8);
    temperature = 2000 + (((int64_t)dT * ms5611_prom[6]) >> 23);

    if (temperature < 2000)  // temperature lower than 20degC 
		{ 
			// temperature lower than 20degC
        delt = temperature - 2000;
        delt = 5 * delt * delt;
        off -= delt >> 1;
        sens -= delt >> 2;
        if (temperature < -1500) 
				{ // temperature lower than -15degC
            delt = temperature + 1500;
            delt = delt * delt;
            off -= 7 * delt;
            sens -= (11 * delt) >> 1;
        }
      temperature -= ((dT * dT) >> 31);
    }
		
    pressure = (((ms5611_up * sens ) >> 21) - off) >> 15;
	
	  ms5611_pressure = pressure;

		temperature_5611=temperature;

}

/*====================================================================================================*/
/*====================================================================================================*
**函数原型 : int32_t MS5611_Get_BaroAlt(void)
**功    能 : 获得气压计算的高度
**输    入 : None
**输    出 : None
**备    注 : 
**====================================================================================================*/
/*====================================================================================================*/
int32_t DEV_MS5611::IIC_MS5611_Get_BaroAlt(void)
{
	return baroAlt;
}


/****************************************************************************************************************************
                                                  SPI配置MS5611驱动
****************************************************************************************************************************/
/*====================================================================================================*/
/*====================================================================================================*
**函数原型 : int32_t MS5611_Get_BaroAlt(void)
**功    能 : 获得气压计算的高度
**输    入 : None
**输    出 : None
**备    注 : 
**====================================================================================================*/
/*====================================================================================================*/
uint8_t DEV_MS5611::SPI_MS5611_Init(void)
{
  uint8_t status;
  Sensor.Sensor_Cs_Enable(MS5611,ENABLE);
  Spi1.SPI1_ReadWriteByte(MS5611_CMD_RESET);
  Sensor.Sensor_Cs_Enable(MS5611,DISABLE);
	System_set.delay_ms(5);
	status=SPI_MS5611_ReadPROM();
	return status;
}

/*====================================================================================================*/
/*====================================================================================================*
**函数原型 : int32_t MS5611_Get_BaroAlt(void)
**功    能 : 获得气压计算的高度
**输    入 : None
**输    出 : None
**备    注 : 
**====================================================================================================*/
/*====================================================================================================*/			
uint8_t DEV_MS5611::SPI_MS5611_SelfTest(void)
{
  int32_t rawPress;
	int32_t rawTemp;
	int32_t deltaT;
	float pressure;
	float temperature;

	SPI_MS5611_StartConversion(MS5611_CMD_ADC_CONV + MS5611_CMD_ADC_4096);
	System_set.delay_ms(10);
	rawPress = SPI_MS5611_GetConversion(MS5611_CMD_ADC_CONV + MS5611_CMD_ADC_4096);

	SPI_MS5611_StartConversion(MS5611_D2 + MS5611_CMD_ADC_4096);
	System_set.delay_ms(10);
	rawTemp = SPI_MS5611_GetConversion(MS5611_D2 + MS5611_CMD_ADC_4096);

	deltaT = SPI_MS5611_CalcDeltaTemp(rawTemp);
	temperature = SPI_MS5611_CalcTemp(deltaT);
	pressure = SPI_MS5611_CalcPressure(rawPress, deltaT);

	if (SPI_MS5611_EvaluateSelfTest(MS5611_ST_PRESS_MIN, MS5611_ST_PRESS_MAX, pressure, "pressure") &&
	SPI_MS5611_EvaluateSelfTest(MS5611_ST_TEMP_MIN, MS5611_ST_TEMP_MAX, temperature, "temperature"))
	{
		
		return 1;
	}
	else
	{
		return 0;
	}

}

/*====================================================================================================*/
/*====================================================================================================*
**函数原型 : int32_t MS5611_Get_BaroAlt(void)
**功    能 : 获得气压计算的高度
**输    入 : None
**输    出 : None
**备    注 : 
**====================================================================================================*/
/*====================================================================================================*/
uint8_t DEV_MS5611::SPI_MS5611_EvaluateSelfTest(float min, float max, float value, char* string)
{

		if (value < min || value > max)
	{

		return 0;
	}
	return 1;
}

/*====================================================================================================*/
/*====================================================================================================*
**函数原型 : int32_t MS5611_Get_BaroAlt(void)
**功    能 : 获得气压计算的高度
**输    入 : None
**输    出 : None
**备    注 : 
**====================================================================================================*/
/*====================================================================================================*/
float DEV_MS5611::SPI_MS5611_GetPressure(uint8_t osr)
{
	// see datasheet page 7 for formulas
	int64_t off,sens;
	int32_t rawPress = SPI_MS5611_RawPressure(osr);
	int64_t dT = (int64_t)SPI_MS5611_GetDeltaTemp(osr);
	if (dT == 0)
	{
		return 0;
	}
	off = (((int64_t)calReg.off) << 16) + ((calReg.tco * dT) >> 7);
	sens = (((int64_t)calReg.psens) << 15) + ((calReg.tcs * dT) >> 8);
	if (rawPress != 0)
	{
		return ((((rawPress * sens) >> 21) - off) >> (15 - EXTRA_PRECISION))
			/ ((1 << EXTRA_PRECISION) * 100.0f);
	}
	else
	{
		return 0;
	}

}
/*====================================================================================================*/
/*====================================================================================================*
**函数原型 : int32_t MS5611_Get_BaroAlt(void)
**功    能 : 获得气压计算的高度
**输    入 : None
**输    出 : None
**备    注 : 
**====================================================================================================*/
/*====================================================================================================*/
float DEV_MS5611::SPI_MS5611_CalcPressure(int32_t rawPress, int32_t dT)
{
	int64_t off;
	int64_t sens;

	if (rawPress == 0 || dT == 0)
	{
		return 0;
	}
		
	off = (((int64_t)calReg.off) << 16) + ((calReg.tco * (int64_t)dT) >> 7);
	sens = (((int64_t)calReg.psens) << 15) + ((calReg.tcs * (int64_t)dT) >> 8);

	return ((((rawPress * sens) >> 21) - off) >> (15 - EXTRA_PRECISION))
			/ ((1 << EXTRA_PRECISION) * 100.0f);

}

/*====================================================================================================*/
/*====================================================================================================*
**函数原型 : int32_t MS5611_Get_BaroAlt(void)
**功    能 : 获得气压计算的高度
**输    入 : None
**输    出 : None
**备    注 : 
**====================================================================================================*/
/*====================================================================================================*/
float DEV_MS5611::SPI_MS5611_GetTemperature(uint8_t osr)
{
 	// see datasheet page 7 for formulas
	int32_t dT;

	dT = SPI_MS5611_GetDeltaTemp(osr);
	if (dT != 0)
	{
		return SPI_MS5611_CalcTemp(dT);
	}
	else
	{
		return 0;
	}

}

/*====================================================================================================*/
/*====================================================================================================*
**函数原型 : int32_t MS5611_Get_BaroAlt(void)
**功    能 : 获得气压计算的高度
**输    入 : None
**输    出 : None
**备    注 : 
**====================================================================================================*/
/*====================================================================================================*/
float DEV_MS5611::SPI_MS5611_CalcTemp(int32_t deltaT)
{
  	if (deltaT == 0)
	{
		return 0;
	}
	else
	{
		return (float)(((1 << EXTRA_PRECISION) * 2000.0f)
				+ (((int64_t)deltaT * calReg.tsens) >> (23 - EXTRA_PRECISION)))
				/ ((1 << EXTRA_PRECISION)* 100.0f);
	}
	
}

/*====================================================================================================*/
/*====================================================================================================*
**函数原型 : int32_t MS5611_Get_BaroAlt(void)
**功    能 : 获得气压计算的高度
**输    入 : None
**输    出 : None
**备    注 : 
**====================================================================================================*/
/*====================================================================================================*/
int32_t DEV_MS5611::SPI_MS5611_GetDeltaTemp(uint8_t osr)
{
		int32_t rawTemp = SPI_MS5611_RawTemperature(osr);
	if (rawTemp != 0)
	{
		return SPI_MS5611_CalcDeltaTemp(rawTemp);
	}
	else
	{
		return 0;
	}

}

/*====================================================================================================*/
/*====================================================================================================*
**函数原型 : int32_t MS5611_Get_BaroAlt(void)
**功    能 : 获得气压计算的高度
**输    入 : None
**输    出 : None
**备    注 : 
**====================================================================================================*/
/*====================================================================================================*/
int32_t DEV_MS5611::SPI_MS5611_CalcDeltaTemp(int32_t rawTemp)
{
	  if (rawTemp == 0)
  {
    return 0;
  }
  else
  {
    return rawTemp - (((int32_t)calReg.tref) << 8);
  }

}
/*====================================================================================================*/
/*====================================================================================================*
**函数原型 : int32_t MS5611_Get_BaroAlt(void)
**功    能 : 获得气压计算的高度
**输    入 : None
**输    出 : None
**备    注 : 
**====================================================================================================*/
/*====================================================================================================*/
int32_t DEV_MS5611::SPI_MS5611_RawPressure(uint8_t osr)
{
	uint64_t now = System_set.Get_Cycle_T(4);
	if (lastPresConv != 0 && (now - lastPresConv) >= 0.01) //0.01==10ms
	{
		lastPresConv = 0;
		return SPI_MS5611_GetConversion(MS5611_CMD_ADC_CONV + osr);
	}
	else
	{
		if (lastPresConv == 0 && lastTempConv == 0)
		{
			SPI_MS5611_StartConversion(MS5611_CMD_ADC_CONV + osr);
			lastPresConv = now;
		}
		return 0;
	}

}

/*====================================================================================================*/
/*====================================================================================================*
**函数原型 : int32_t MS5611_Get_BaroAlt(void)
**功    能 : 获得气压计算的高度
**输    入 : None
**输    出 : None
**备    注 : 
**====================================================================================================*/
/*====================================================================================================*/
int32_t DEV_MS5611::SPI_MS5611_RawTemperature(uint8_t osr)
{
	uint64_t now = System_set.Get_Cycle_T(5);
	if (lastTempConv != 0 && (now - lastTempConv) >= 0.01)
	{
		lastTempConv = 0;
		tempCache = SPI_MS5611_GetConversion(MS5611_D2 + osr);
		return tempCache;
	}
	else
	{
		if (lastTempConv == 0 && lastPresConv == 0)
		{
			SPI_MS5611_StartConversion(MS5611_D2 + osr);
			lastTempConv = now;
		}
		return tempCache;
	}


}

/*====================================================================================================*/
/*====================================================================================================*
**函数原型 : int32_t MS5611_Get_BaroAlt(void)
**功    能 : 获得气压计算的高度
**输    入 : None
**输    出 : None
**备    注 : 
**====================================================================================================*/
/*====================================================================================================*/
uint8_t DEV_MS5611::SPI_MS5611_ReadPROM(void)
{ 
	uint8_t buffer[MS5611_PROM_REG_SIZE];
	uint16_t* pCalRegU16 = (uint16_t*)&calReg;
	int32_t i = 0, j = 0;
	uint8_t status = 0;

	
	
	for (i = 0; i < MS5611_PROM_REG_COUNT; i++)
	{
		 Sensor.Sensor_Cs_Enable(MS5611,ENABLE);
		// start read sequence
		status = Spi1.SPI1_ReadWriteByte(MS5611_PROM_BASE_ADDR + (i * MS5611_PROM_REG_SIZE));
		// Read conversion
		if (status)
		{
			for(j=0; j<MS5611_PROM_REG_SIZE; j++)
				buffer[j] = Spi1.SPI1_ReadWriteByte(0x00);

			pCalRegU16[i] = ((uint16_t)buffer[0] << 8) | buffer[1];
		}
		 Sensor.Sensor_Cs_Enable(MS5611,DISABLE);
		System_set.delay_ms(1);
	}

}

/*====================================================================================================*/
/*====================================================================================================*
**函数原型 : int32_t MS5611_Get_BaroAlt(void)
**功    能 : 获得气压计算的高度
**输    入 : None
**输    出 : None
**备    注 : 
**====================================================================================================*/
/*====================================================================================================*/
void DEV_MS5611::SPI_MS5611_StartConversion(uint8_t command)
{
 	Sensor.Sensor_Cs_Enable(MS5611,ENABLE);
	Spi1.SPI1_ReadWriteByte(command);
	Sensor.Sensor_Cs_Enable(MS5611,DISABLE);
}
/*====================================================================================================*/
/*====================================================================================================*
**函数原型 : int32_t MS5611_Get_BaroAlt(void)
**功    能 : 获得气压计算的高度
**输    入 : None
**输    出 : None
**备    注 : 
**====================================================================================================*/
/*====================================================================================================*/
int32_t DEV_MS5611::SPI_MS5611_GetConversion(uint8_t command)
{
  uint8_t i;
	int32_t conversion = 0;
	uint8_t buffer[MS5611_D1D2_SIZE];

	Sensor.Sensor_Cs_Enable(MS5611,ENABLE);
	
	// start read sequence
	Spi1.SPI1_ReadWriteByte(0);
	// Read conversion
	for(i=0; i<MS5611_D1D2_SIZE; i++)
		buffer[i] = Spi1.SPI1_ReadWriteByte(0x00);
	
	Sensor.Sensor_Cs_Enable(MS5611,DISABLE);

	conversion = ((int32_t)buffer[0] << 16) |((int32_t)buffer[1] << 8) | buffer[2];

	return conversion;
	
}

/*====================================================================================================*/
/*====================================================================================================*
**函数原型 : int32_t MS5611_Get_BaroAlt(void)
**功    能 : 获得气压计算的高度
**输    入 : None
**输    出 : None
**备    注 : 
**====================================================================================================*/
/*====================================================================================================*/
static uint8_t readState=0;
void  DEV_MS5611::SPI_MS5611_GetData(float* pressure, float* temperature, float* asl)
{
    int32_t dT;
    int32_t tempPressureRaw, tempTemperatureRaw;

    if (readState == 0)
    {
        // read temp
        ++readState;
        tempTemperatureRaw = SPI_MS5611_GetConversion(MS5611_D2 + MS5611_CMD_ADC_4096);
		dT = tempTemperatureRaw - (((int32_t)calReg.tref) << 8);
		_TEMP = 2000 + (int32_t)(((int64_t)dT * calReg.tsens) >> 23);
		
		/* base sensor scale/offset values */
		_SENS = ((int64_t)calReg.psens << 15) + (((int64_t)calReg.tcs * dT) >> 8);
		_OFF  = ((int64_t)calReg.off << 16) + (((int64_t)calReg.tco * dT) >> 7);		

		/* temperature compensation */
		if (_TEMP < 2000) 
		{

			int32_t T2 = (dT * dT) >> 31;

			int64_t f = ((int64_t)_TEMP - 2000) * ((int64_t)_TEMP - 2000);
			int64_t OFF2 = 5 * f >> 1;
			int64_t SENS2 = 5 * f >> 2;

			if (_TEMP < -1500) 
			{
				int64_t f2 = (_TEMP + 1500) * (_TEMP + 1500);
				OFF2 += 7 * f2;
				SENS2 += 11 * f2 >> 1;
			}

			_TEMP -= T2;
			_OFF  -= OFF2;
			_SENS -= SENS2;
		}
		
        // cmd to read pressure
        SPI_MS5611_StartConversion(MS5611_CMD_ADC_CONV + MS5611_CMD_ADC_4096);
    }
    else
    {
        // read pressure
        ++readState;
        tempPressureRaw = SPI_MS5611_GetConversion(MS5611_CMD_ADC_CONV + MS5611_CMD_ADC_4096);

		/* pressure calculation, result in Pa */
		int32_t P = (((tempPressureRaw * _SENS) >> 21) - _OFF) >> 15;

		/* generate a new report */
		*temperature = _TEMP * 0.01f;
		*pressure = P * 0.01f;		/* convert to millibar */
		
 		/* altitude calculations based on http://www.kansasflyer.org/index.asp?nav=Avi&sec=Alti&tab=Theory&pg=1 */

		/*
		 * PERFORMANCE HINT:
		 *
		 * The single precision calculation is 50 microseconds faster than the double
		 * precision variant. It is however not obvious if double precision is required.
		 * Pending more inspection and tests, we'll leave the double precision variant active.
		 *
		 * Measurements:
		 * 	double precision: ms5611_read: 992 events, 258641us elapsed, min 202us max 305us
		 *	single precision: ms5611_read: 963 events, 208066us elapsed, min 202us max 241us
		 */


		/* tropospheric properties (0-11km) for standard atmosphere */
		const float T1 = 15.0f + 273.15f;	/* temperature at base height in Kelvin */
		const float a  = -6.5f / 1000.f;	/* temperature gradient in degrees per metre */
		const float g  = 9.80665f;	/* gravity constant in m/s/s */
		const float R  = 287.05f;	/* ideal gas constant in J/kg/K */

		/* current pressure at MSL in kPa */
		float p1 = _msl_pressure / 1000.0f;

		/* measured pressure in kPa */
		float p = P / 1000.0f;

		/*
		 * Solve:
		 *
		 *     /        -(aR / g)     \
		 *    | (p / p1)          . T1 | - T1
		 *     \                      /
		 * h = -------------------------------  + h1
		 *                   a
		 */
		*asl = (((powf((p / p1), (-(a * R) / g))) * T1) - T1) / a;

        if (readState == PRESSURE_PER_TEMP)
		{
            // cmd to read temp
            SPI_MS5611_StartConversion(MS5611_D2 + MS5611_CMD_ADC_4096);
            readState = 0;
        }
        else
        {
            // cmd to read pressure
            SPI_MS5611_StartConversion(MS5611_CMD_ADC_CONV + MS5611_CMD_ADC_4096);
        }
    }
}
/*====================================================================================================*/
/*====================================================================================================*
**函数原型 : int32_t MS5611_Get_BaroAlt(void)
**功    能 : 获得气压计算的高度
**输    入 : None
**输    出 : None
**备    注 : 
**====================================================================================================*/
/*====================================================================================================*/
float DEV_MS5611::SPI_MS5611_PressureToAltitude(float* pressure)
{


}





/**********************************************************************************************************************
*                                      file---end
**********************************************************************************************************************/

